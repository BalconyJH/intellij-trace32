// Synthetic child script used for path and call-graph examples.
PRINT "Child script"
ENDDO
