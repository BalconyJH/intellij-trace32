// Target for the DO path navigation demonstration.
PRINT "Child script."
ENDDO
